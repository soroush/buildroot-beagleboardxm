## configs/beagleboardxm_defconfig
```kconfig
BR2_arm=y
BR2_cortex_a8=y
BR2_ARM_EABIHF=y
BR2_KERNEL_HEADERS_VERSION=y
BR2_DEFAULT_KERNEL_VERSION="3.14.4"
BR2_PACKAGE_HOST_LINUX_HEADERS_CUSTOM_3_14=y
BR2_TARGET_GENERIC_GETTY_PORT="ttyO2"
BR2_LINUX_KERNEL=y
BR2_LINUX_KERNEL_CUSTOM_GIT=y
BR2_LINUX_KERNEL_CUSTOM_REPO_URL="git://git.ti.com/~soroush/ti-linux-kernel/ti-linux-kernel-beagleboardxm.git"
BR2_LINUX_KERNEL_CUSTOM_REPO_VERSION="8c1090e06cfee52c96606e9c1f584f27f13b6192"
BR2_LINUX_KERNEL_DEFCONFIG="beagleboardxm"
BR2_LINUX_KERNEL_APPENDED_UIMAGE=y
BR2_LINUX_KERNEL_UIMAGE_LOADADDR="80008000"
BR2_LINUX_KERNEL_INTREE_DTS_NAME="omap3-beagle-xm"
BR2_LINUX_KERNEL_INSTALL_TARGET=y
BR2_PACKAGE_GST_OMAPFB=y
BR2_TARGET_UBOOT=y
BR2_TARGET_UBOOT_BOARDNAME="omap3_beagle"
BR2_TARGET_UBOOT_FORMAT_IMG=y
BR2_TARGET_UBOOT_SPL=y
BR2_TARGET_UBOOT_SPL_NAME="MLO"
BR2_TARGET_UBOOT_ENVIMAGE=y
BR2_TARGET_UBOOT_ENVIMAGE_SOURCE="uEnv.txt"
BR2_TARGET_UBOOT_ENVIMAGE_SIZE="0x4200"
BR2_PACKAGE_HOST_E2FSPROGS=y
BR2_PACKAGE_HOST_GENEXT2FS=y
```
